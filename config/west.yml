## config/west.yml
```yaml
manifest:
  defaults:
    revision: v0.3
  remotes:
    - name: zmkfirmware
      url-base: https://github.com/zmkfirmware
#    - name: m165437
#      url-base: https://github.com/M165437
    - name: infely
      url-base: https://github.com/infely
  projects:
    - name: zmk
      remote: zmkfirmware
      import: app/west.yml
    - name: nice-view-battery
      remote: infely
      revision: main
#    - name: nice-view-gem
#      remote: m165437
#      revision: main
  self:
    path: config
```
